## main/Kconfig.projbuild
```kconfig
menu "Firefly Chatbot Configuration"
    config SERVER_API_URL
        string "WebSocket API URL"
        default ""
        help
            Specifies which server will this device communicate with.

    config WIFI_SSID
        string "Wi-FI SSID"

    config WIFI_PASSWORD
        string "Wi-Fi Password"

    config BUILD_CELLULAR
        bool "Build ML307R support"
        default n
        help
            Enable cellular network support via ML307R (DO NOT ENABLE, WIP)

    choice DEFAULT_NETWORK_IMPL
        prompt "Default network implementation"
        default NETWORK_IMPL_WIFI

        config NETWORK_IMPL_WIFI
            bool "Wi-Fi"

        config NETWORK_IMPL_CELLULAR
            bool "Cellular"
            depends on BUILD_CELLULAR
    endchoice

    config APP_LOG_TAG
        string "Default application log tag"
        default "App"

    config OWNER_NAME
        string "Name of the owner of this device"
        default ""

    config DEFAULT_TASK_STACK_SIZE
        int "Default stack depth of tasks"
        default 10240

    config MAX_PACKET_VERSION
        int "Maximum supported packet version"
        default 1

    config AUDIO_RECORD_SAMPLE_RATE
        int "Sample rate used when recording audio"
        default 8000

    config AUDIO_PLAY_SAMPLE_RATE
        int "Sample rate used when playing audio"
        default 32000

    config AUDIO_RECORD_CHANNELS
        int "Record channels"
        default 1

    config AUDIO_PLAY_CHANNELS
        int "Play channels"
        default 1

    config AUDIO_RECORD_BPS
        int "Bits per sample used when recording audio"
        default 16

    config AUDIO_PLAY_BPS
        int "Bits per sample used when playing audio"
        default 16

endmenu
```
